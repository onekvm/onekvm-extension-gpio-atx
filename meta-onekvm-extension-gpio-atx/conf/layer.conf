## meta-onekvm-extension-gpio-atx/conf/layer.conf
```bitbake
BBPATH .= ":${LAYERDIR}"
BBFILES += "${LAYERDIR}/recipes-*/*/*.bb ${LAYERDIR}/recipes-*/*/*.bbappend"
BBFILE_COLLECTIONS += "onekvm-extension-gpio-atx"
BBFILE_PATTERN_onekvm-extension-gpio-atx := "^${LAYERDIR}/"
BBFILE_PRIORITY_onekvm-extension-gpio-atx = "8"
LAYERDEPENDS_onekvm-extension-gpio-atx = "core onekvm"
LAYERSERIES_COMPAT_onekvm-extension-gpio-atx = "wrynose"
```
